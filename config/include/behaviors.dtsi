#include <dt-bindings/zmk/keys.h>
#include <behaviors.dtsi>

// Alt+Tab swapper
/// {
//    behaviors {
//        swapper: swapper {
//            compatible = "zmk,behavior-tri-state";
//            #binding-cells = <0>;
//            bindings = <&kt LALT>, <&kp TAB>, <&kt LALT>;
//        };
//    };
//};
